## config/boards/shields/kovacszkgaming/Kconfig.defconfig
```kconfig
if SHIELD_KOVACSZKGAMING

config ZMK_KEYBOARD_NAME
    default "kovcszk"

    endif
```

## config/boards/shields/kovacszkgaming/Kconfig.shield
```kconfig
config SHIELD_KOVACSZKGAMING
    def_bool $(shields_list_contains, kovacszkgaming)
```
